/* SPDX-License-Identifier: Apache-2.0 */

/* A display without a window, at the application's 800 x 480 viewport. */
/ {
	chosen {
		zephyr,display = &dummy_dc;
	};

	dummy_dc: dummy_dc {
		compatible = "zephyr,dummy-dc";
		width = <800>;
		height = <480>;
	};
};
