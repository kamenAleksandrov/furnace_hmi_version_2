## CMakeLists.txt
```
# SPDX-License-Identifier: Apache-2.0

cmake_minimum_required(VERSION 3.28.0)

find_package(Zephyr 4.4.0 EXACT REQUIRED HINTS $ENV{ZEPHYR_BASE})
project(furnace_hmi_zephyr_controller_client LANGUAGES C)

set(FURNACE_HMI_ROOT "${CMAKE_CURRENT_LIST_DIR}/../../..")
set(FURNACE_HMI_WIRE_DIR "${FURNACE_HMI_ROOT}/app/hmi/protocol/wire")
set(FURNACE_HMI_TESTS_DIR "${FURNACE_HMI_ROOT}/tests/client")

target_sources(app PRIVATE
  src/main.c
  "${FURNACE_HMI_TESTS_DIR}/controller_client_tests.c"
  "${FURNACE_HMI_TESTS_DIR}/controller_dashboard_tests.c"
  "${FURNACE_HMI_ROOT}/app/hmi/client/src/controller_client.c"
  "${FURNACE_HMI_ROOT}/app/hmi/client/src/controller_dashboard.c"
  "${FURNACE_HMI_ROOT}/app/hmi/model/src/dashboard_model.c"
  "${FURNACE_HMI_ROOT}/app/hmi/transport/src/loopback_port.c"
  "${FURNACE_HMI_WIRE_DIR}/src/crc32.c"
  "${FURNACE_HMI_WIRE_DIR}/src/wire_frame.c"
  "${FURNACE_HMI_WIRE_DIR}/src/wire_messages.c"
)

target_include_directories(app PRIVATE
  "${FURNACE_HMI_TESTS_DIR}"
  "${FURNACE_HMI_ROOT}/app/hmi/client/include"
  "${FURNACE_HMI_ROOT}/app/hmi/transport/include"
  "${FURNACE_HMI_ROOT}/app/hmi/model/include"
  "${FURNACE_HMI_WIRE_DIR}/include"
)
```

## prj.conf
```kconfig
# SPDX-License-Identifier: Apache-2.0

CONFIG_ZTEST=y
CONFIG_STD_C17=y
# The fixture and the client are static; the test thread needs room for the scenarios' locals.
CONFIG_ZTEST_STACK_SIZE=8192
```

## src/main.c
```c
/* SPDX-License-Identifier: Apache-2.0 */

#include <zephyr/sys/printk.h>
#include <zephyr/ztest.h>

#include "controller_client_tests.h"

void controller_client_tests_report(const char *check, const char *scenario)
{
    printk("FAIL %s: %s\n", scenario, check);
}

/** The controller client's scenarios, against a scripted controller, on Zephyr. */
ZTEST(furnace_hmi_client, test_controller_link_scenarios_pass)
{
    zassert_equal(controller_client_tests_run(), 0, "controller client failures (see the log)");
    zassert_equal(controller_dashboard_tests_run(), 0, "dashboard mapping failures (see the log)");
}

ZTEST_SUITE(furnace_hmi_client, NULL, NULL, NULL, NULL, NULL);
```
