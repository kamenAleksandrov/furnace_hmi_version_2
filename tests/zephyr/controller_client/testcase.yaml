## tests/zephyr/controller_client/testcase.yaml
```yaml
# SPDX-License-Identifier: Apache-2.0

tests:
  furnace_hmi.client.controller_link:
    integration_platforms:
      - qemu_x86
      - native_sim
    platform_allow:
      - qemu_x86
      - native_sim
    tags:
      - protocol
```

## tests/zephyr/foundation/testcase.yaml
```yaml
# SPDX-License-Identifier: Apache-2.0

tests:
  furnace_hmi.foundation.probe:
    integration_platforms:
      - qemu_x86
    platform_allow:
      - qemu_x86
    tags:
      - foundation
```

## tests/zephyr/operator/testcase.yaml
```yaml
# SPDX-License-Identifier: Apache-2.0

tests:
  furnace_hmi.presentation.operator_content:
    integration_platforms:
      - native_sim
    platform_allow:
      - native_sim
      - native_sim/native/64
    tags:
      - presentation
```

## tests/zephyr/presentation/testcase.yaml
```yaml
# SPDX-License-Identifier: Apache-2.0

tests:
  furnace_hmi.presentation.availability:
    integration_platforms:
      - native_sim
    platform_allow:
      - native_sim
      - native_sim/native/64
    tags:
      - presentation
```
