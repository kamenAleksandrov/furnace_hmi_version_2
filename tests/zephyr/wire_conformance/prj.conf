## CMakeLists.txt
```
# SPDX-License-Identifier: Apache-2.0

cmake_minimum_required(VERSION 3.28.0)

find_package(Zephyr 4.4.0 EXACT REQUIRED HINTS $ENV{ZEPHYR_BASE})
project(furnace_hmi_zephyr_wire_conformance LANGUAGES C)

set(FURNACE_HMI_WIRE_DIR "${CMAKE_CURRENT_LIST_DIR}/../../../app/hmi/protocol/wire")
set(FURNACE_HMI_CONFORMANCE_DIR "${CMAKE_CURRENT_LIST_DIR}/../../conformance/wire")

target_sources(app PRIVATE
  src/main.c
  "${FURNACE_HMI_WIRE_DIR}/src/crc32.c"
  "${FURNACE_HMI_WIRE_DIR}/src/wire_frame.c"
  "${FURNACE_HMI_WIRE_DIR}/src/wire_messages.c"
  "${FURNACE_HMI_CONFORMANCE_DIR}/wire_conformance.c"
  "${FURNACE_HMI_CONFORMANCE_DIR}/wire_vectors_gen.c"
)

target_include_directories(app PRIVATE
  "${FURNACE_HMI_WIRE_DIR}/include"
  "${FURNACE_HMI_CONFORMANCE_DIR}"
)
```

## prj.conf
```kconfig
# SPDX-License-Identifier: Apache-2.0

CONFIG_ZTEST=y
CONFIG_STD_C17=y
```

## src/main.c
```c
/* SPDX-License-Identifier: Apache-2.0 */

#include <zephyr/sys/printk.h>
#include <zephyr/ztest.h>

#include "wire_conformance.h"

void wire_conformance_report(const char *check, const char *name)
{
    printk("FAIL %s: %s\n", name, check);
}

/** The copy of the controller's codec passes the controller's golden vectors on Zephyr. */
ZTEST(furnace_hmi_wire, test_controller_golden_vectors_pass)
{
    zassert_equal(wire_conformance_run(), 0, "wire conformance failures (see the log)");
}

ZTEST_SUITE(furnace_hmi_wire, NULL, NULL, NULL, NULL, NULL);
```
