## CMakeLists.txt
```
# SPDX-License-Identifier: Apache-2.0

cmake_minimum_required(VERSION 3.28.0)

# The LVGL presentation is built for boards with a display: for now
# native_sim/native/64, whose SDL display opens a window on the host. Other
# boards (qemu_x86) build the console probe.
if(BOARD MATCHES "^native_sim/native/64")
  list(APPEND EXTRA_CONF_FILE "${CMAKE_CURRENT_LIST_DIR}/gui.conf")
endif()

find_package(Zephyr 4.4.0 EXACT REQUIRED HINTS $ENV{ZEPHYR_BASE})
project(furnace_hmi_zephyr_foundation LANGUAGES C)

set(FURNACE_HMI_FOUNDATION_DIR "${CMAKE_CURRENT_LIST_DIR}/../hmi/foundation")
set(FURNACE_HMI_MODEL_DIR "${CMAKE_CURRENT_LIST_DIR}/../hmi/model")
set(FURNACE_HMI_STRINGS_DIR "${CMAKE_CURRENT_LIST_DIR}/../hmi/presentation/strings")
set(FURNACE_HMI_AVAILABILITY_DIR "${CMAKE_CURRENT_LIST_DIR}/../hmi/presentation/state_availability")

target_sources(app PRIVATE
  "${FURNACE_HMI_FOUNDATION_DIR}/src/foundation.c"
  "${FURNACE_HMI_MODEL_DIR}/src/dashboard_model.c"
  "${FURNACE_HMI_STRINGS_DIR}/src/ui_strings.c"
  "${FURNACE_HMI_STRINGS_DIR}/generated/ui_strings_catalogue.c"
)

target_include_directories(app PRIVATE
  "${FURNACE_HMI_FOUNDATION_DIR}/include"
  "${FURNACE_HMI_MODEL_DIR}/include"
  "${FURNACE_HMI_STRINGS_DIR}/include"
  "${FURNACE_HMI_STRINGS_DIR}/src"
)

if(BOARD STREQUAL "native_sim" AND BOARD_QUALIFIERS MATCHES "^/?native/64$" AND NOT CONFIG_LVGL)
  message(FATAL_ERROR "native_sim/native/64 builds the LVGL application: pass the board with -b "
                      "(or -DBOARD) so that gui.conf is applied")
endif()

if(CONFIG_LVGL)
  # The GUI build is the HMI: the operator screens (Phase 21 M21-2b) and the
  # controller link (M21-3).
  set(FURNACE_HMI_PRESENTATION_DIR "${CMAKE_CURRENT_LIST_DIR}/../hmi/presentation")
  set(FURNACE_HMI_MARKER_DIR "${FURNACE_HMI_PRESENTATION_DIR}/development_marker")
  set(FURNACE_HMI_OPERATOR_DIR "${FURNACE_HMI_PRESENTATION_DIR}/operator")
  set(FURNACE_HMI_FONTS_DIR "${FURNACE_HMI_PRESENTATION_DIR}/fonts")
  set(FURNACE_HMI_ICONS_DIR "${FURNACE_HMI_PRESENTATION_DIR}/icons")
  set(FURNACE_HMI_THEME_DIR "${FURNACE_HMI_PRESENTATION_DIR}/theme")
  set(FURNACE_HMI_CLIENT_DIR "${CMAKE_CURRENT_LIST_DIR}/../hmi/client")
  set(FURNACE_HMI_TRANSPORT_DIR "${CMAKE_CURRENT_LIST_DIR}/../hmi/transport")
  set(FURNACE_HMI_WIRE_DIR "${CMAKE_CURRENT_LIST_DIR}/../hmi/protocol/wire")
  file(GLOB FURNACE_HMI_FONT_SOURCES "${FURNACE_HMI_FONTS_DIR}/generated/*.c")
  target_sources(app PRIVATE
    src/gui_main.c
    src/controller_link.c
    src/operator_commands.c
    "${FURNACE_HMI_OPERATOR_DIR}/src/operator_screens.c"
    "${FURNACE_HMI_OPERATOR_DIR}/src/operator_theme.c"
    "${FURNACE_HMI_MARKER_DIR}/src/development_marker.c"
    ${FURNACE_HMI_FONT_SOURCES}
    "${FURNACE_HMI_ICONS_DIR}/generated/hmi_icons.c"
    "${FURNACE_HMI_ICONS_DIR}/generated/support_qr.c"
    "${FURNACE_HMI_THEME_DIR}/generated/hmi_theme.c"
    "${FURNACE_HMI_CLIENT_DIR}/src/controller_client.c"
    "${FURNACE_HMI_CLIENT_DIR}/src/controller_dashboard.c"
    "${FURNACE_HMI_WIRE_DIR}/src/crc32.c"
    "${FURNACE_HMI_WIRE_DIR}/src/wire_frame.c"
    "${FURNACE_HMI_WIRE_DIR}/src/wire_messages.c"
  )
  target_include_directories(app PRIVATE
    "${FURNACE_HMI_OPERATOR_DIR}/include"
    "${FURNACE_HMI_MARKER_DIR}/include"
    "${FURNACE_HMI_FONTS_DIR}/include"
    "${FURNACE_HMI_ICONS_DIR}/include"
    "${FURNACE_HMI_THEME_DIR}/include"
    "${FURNACE_HMI_CLIENT_DIR}/include"
    "${FURNACE_HMI_TRANSPORT_DIR}/include"
    "${FURNACE_HMI_WIRE_DIR}/include"
  )
else()
  target_sources(app PRIVATE src/main.c)
endif()
```

## sample.yaml
```
# SPDX-License-Identifier: Apache-2.0

sample:
  name: Furnace HMI V2 Zephyr foundation proof
tests:
  sample.furnace_hmi.foundation:
    build_only: true
    platform_allow:
      - qemu_x86
    tags:
      - foundation
  sample.furnace_hmi.gui:
    # Opens an SDL window, so Twister only builds it; the presentation
    # behavior is tested headless by tests/zephyr/presentation.
    build_only: true
    platform_allow:
      - native_sim/native/64
    tags:
      - presentation
```

## prj.conf
```kconfig
# SPDX-License-Identifier: Apache-2.0

CONFIG_PRINTK=y
```

## gui.conf
```kconfig
# SPDX-License-Identifier: Apache-2.0

# LVGL for the shared presentation: the features the desktop program enables in
# simulator/desktop/lv_conf.h, so both builds draw the same screens. Used by the
# application on boards with a display (CMakeLists.txt) and by
# tests/zephyr/presentation.

CONFIG_LVGL=y
CONFIG_LV_COLOR_DEPTH_32=y
# Below the 32-bit sys_heap limit (just under 256 KiB without
# CONFIG_SYS_HEAP_BIG_ONLY); the desktop program's pool is larger.
CONFIG_LV_Z_MEM_POOL_SIZE=196608
# native_sim runs threads on host stacks, so this size is not validated there.
CONFIG_MAIN_STACK_SIZE=8192

CONFIG_LOG=y
CONFIG_LV_USE_LOG=y

CONFIG_LV_USE_BUTTON=y
CONFIG_LV_USE_LABEL=y
CONFIG_LV_USE_TEXTAREA=y
CONFIG_LV_USE_CHART=y
CONFIG_LV_GRADIENT_MAX_STOPS=5

CONFIG_LV_FONT_MONTSERRAT_14=y
CONFIG_LV_FONT_MONTSERRAT_16=y
CONFIG_LV_FONT_MONTSERRAT_20=y
CONFIG_LV_FONT_MONTSERRAT_24=y
CONFIG_LV_FONT_MONTSERRAT_32=y
CONFIG_LV_FONT_MONTSERRAT_40=y
```

## boards/native_sim_native_64.conf
```kconfig
# SPDX-License-Identifier: Apache-2.0

# native_sim (64-bit, which links the host's SDL2): the SDL display and the SDL
# pointer, a window on the developer's desktop (WSLg in WSL).
CONFIG_DISPLAY=y
CONFIG_INPUT=y

# The controller link on a host serial device (the overlay), and a random client
# session ID at each boot (run with --seed-random: the default seed is fixed).
CONFIG_SERIAL=y
CONFIG_UART_NATIVE_TTY=y
CONFIG_ENTROPY_GENERATOR=y
```

## boards/native_sim_native_64.overlay
```dts
/* SPDX-License-Identifier: Apache-2.0 */

/*
 * The desktop program's 800 x 480 development viewport. Not a production
 * display selection.
 */
&sdl_dc {
	width = <800>;
	height = <480>;
};

/*
 * SIMULATION ONLY. The controller link: a host serial device. By default the
 * path tools/controller_link_demo.py links to its pseudo-terminal; another
 * device (a USB serial port) is given with --controller_link_port=<path>. No
 * production link, line or baud rate is implied (ADR-0006).
 */
/ {
	controller_link: controller_link {
		compatible = "zephyr,native-tty-uart";
		status = "okay";
		serial-port = "/tmp/furnace-hmi-controller-link";
		current-speed = <115200>;
	};
};
```

## src/main.c
```c
/* SPDX-License-Identifier: Apache-2.0 */

#include <zephyr/sys/printk.h>

#include <furnace_hmi/foundation.h>
#include <furnace_hmi/ui_strings.h>

int main(void)
{
    printk("%s (build probe %u)\n",
           furnace_hmi_ui_string(FURNACE_HMI_UI_STRING_APPLICATION_TITLE),
           (unsigned int)furnace_hmi_foundation_probe_version());
    return 0;
}
```

## src/controller_link.c
```c
/* SPDX-License-Identifier: Apache-2.0 */

/*
 * The controller link on Zephyr (Phase 21 M21-3). A thread of its own polls the
 * UART and the portable client, and publishes the observation to a single-slot
 * mailbox: the latest value, never a queue that could fall behind. Only the GUI
 * context reads the mailbox, without waiting, and only it touches LVGL
 * (ADR-0005). Nothing here waits on the controller.
 */

#include <zephyr/device.h>
#include <zephyr/drivers/uart.h>
#include <zephyr/kernel.h>
#include <zephyr/random/random.h>
#include <zephyr/sys/printk.h>

#include <furnace_hmi/controller_client.h>

#include "controller_link.h"

#define LINK_POLL_MS 5
/* Below the GUI thread (main, priority 0): the link never preempts drawing. */
#define LINK_PRIORITY K_PRIO_PREEMPT(2)
#define LINK_STACK_SIZE 4096
/* The age of what is shown stays within this, even when nothing else changes. */
#define PUBLISH_INTERVAL_MS 200U
/* The console trace: every change of link or availability, and at most once a second else. */
#define TRACE_INTERVAL_MS 1000U

static const struct device *const link_uart = DEVICE_DT_GET(DT_NODELABEL(controller_link));

static furnace_hmi_controller_client_t client;

static K_MUTEX_DEFINE(mailbox_lock);
static furnace_hmi_controller_observation_t mailbox;
static uint32_t mailbox_sequence;

/* Commands from the GUI context to the link thread: one slot each for ordinary and Stop. */
struct command_slot {
    bool full;
    furnace_hmi_command_t command;
    uint32_t submission;
};
static struct k_spinlock command_lock;
static struct command_slot command_slots[2];
static uint32_t last_submission;

K_THREAD_STACK_DEFINE(link_stack, LINK_STACK_SIZE);
static struct k_thread link_thread;

static const char *const link_names[FURNACE_HMI_LINK_COUNT] = {
    "CONNECTING", "INCOMPATIBLE", "SYNCHRONIZING", "CONNECTED", "SILENT",
};
static const char *const availability_names[] = {"UNAVAILABLE", "STALE", "CURRENT"};

static size_t uart_read(void *context, uint8_t *buffer, size_t capacity)
{
    size_t n = 0U;

    (void)context;
    while (n < capacity && uart_poll_in(link_uart, &buffer[n]) == 0) {
        n++;
    }
    return n;
}

static size_t uart_write(void *context, const uint8_t *bytes, size_t length)
{
    (void)context;
    for (size_t i = 0U; i < length; i++) {
        uart_poll_out(link_uart, bytes[i]);
    }
    return length;
}

static uint32_t new_client_session_id(void *context)
{
    uint32_t id;

    (void)context;
    do {
        id = sys_rand32_get();
    } while (id == 0U);
    return id;
}

static void publish(const furnace_hmi_controller_observation_t *observation)
{
    (void)k_mutex_lock(&mailbox_lock, K_FOREVER);
    mailbox = *observation;
    mailbox_sequence++;
    (void)k_mutex_unlock(&mailbox_lock);
}

/* Submit what the GUI context handed over; the client reports each outcome. */
static void take_commands(void)
{
    struct command_slot taken[2];
    k_spinlock_key_t key = k_spin_lock(&command_lock);

    for (size_t i = 0U; i < 2U; i++) {
        taken[i] = command_slots[i];
        command_slots[i].full = false;
    }
    k_spin_unlock(&command_lock, key);
    if (taken[1].full) {
        (void)furnace_hmi_controller_client_submit(&client, &taken[1].command,
                                                   taken[1].submission);
        /*
         * The operator pressed Stop after this command, before it was sent: it is
         * dropped, never sent after the Stop (review F2).
         */
        if (taken[0].full) {
            furnace_hmi_controller_client_refuse(&client, &taken[0].command, taken[0].submission,
                                                 FURNACE_HMI_COMMAND_LOCAL_SUPERSEDED_BY_STOP);
        }
    } else if (taken[0].full) {
        (void)furnace_hmi_controller_client_submit(&client, &taken[0].command,
                                                   taken[0].submission);
    }
}

/* One line, key=value, for people and for tools/controller_link_demo.py. */
static void trace(const furnace_hmi_controller_observation_t *o)
{
    printk("hmi-link: link=%s availability=%s client=%08x session=%02x%02x%02x%02x "
           "changes=%u fw=%u boot=%u proto=%u.%u hello=%u status=%u temp=%d validity=%u "
           "age=%u measurement=%u qualified=%u run_state=%u run=%u inhibited=%u latched=%u "
           "unack=%u faults=%u outdated=%u fresh=%u ready=%u requests=%u request_state=%u "
           "gaps=%u regressions=%u incomplete=%u caps_rejected=%u dropped=%u "
           "command=%u/%u/%u/%u stop=%u/%u/%u\n",
           link_names[o->link], availability_names[o->availability],
           (unsigned int)o->client_session_id, o->session_id[0], o->session_id[1],
           o->session_id[2], o->session_id[3], (unsigned int)o->controller_session_changes,
           (unsigned int)o->firmware_id, (unsigned int)o->boot_count, o->controller_proto_major,
           o->controller_proto_minor, o->hello_result, (unsigned int)o->status_sequence,
           (int)o->temperature_decicelsius, o->temperature_validity,
           (unsigned int)o->temperature_age_ms, o->measurement_state,
           (unsigned int)o->measurement_qualified_s, o->run_state, (unsigned int)o->run_id,
           o->heating_inhibited ? 1U : 0U, o->latched_class, o->unacknowledged_faults,
           o->faults_valid ? (unsigned int)o->fault_count : 0U, o->faults_outdated ? 1U : 0U,
           o->session_fresh ? 1U : 0U, o->store_readiness, (unsigned int)o->snapshots_requested,
           o->snapshot_request, (unsigned int)o->event_gaps,
           (unsigned int)o->status_regressions, (unsigned int)o->snapshots_incomplete,
           (unsigned int)o->capabilities_rejected, (unsigned int)o->frames_dropped,
           o->command.kind, o->command.state, o->command.reason, o->command.unresolved_cause,
           o->stop.state, o->stop.reason, o->stop.unresolved_cause);
}

static void link_main(void *p1, void *p2, void *p3)
{
    const furnace_hmi_controller_client_config_t config = {
        .port = {.read = uart_read, .write = uart_write, .context = NULL},
        .new_client_session_id = new_client_session_id,
        .id_context = NULL,
    };
    uint32_t published_generation;
    uint32_t last_publish;
    uint32_t last_trace;
    furnace_hmi_link_state_t traced_link = FURNACE_HMI_LINK_COUNT;
    furnace_hmi_state_availability_t traced_availability = FURNACE_HMI_STATE_AVAILABILITY_COUNT;

    (void)p1;
    (void)p2;
    (void)p3;
    furnace_hmi_controller_client_init(&client, &config, k_uptime_get_32());
    published_generation = furnace_hmi_controller_client_generation(&client) - 1U;
    last_publish = k_uptime_get_32();
    last_trace = last_publish;

    for (;;) {
        const uint32_t now = k_uptime_get_32();
        const furnace_hmi_controller_observation_t *o;

        furnace_hmi_controller_client_poll(&client, now);
        take_commands();
        o = furnace_hmi_controller_client_observation(&client);
        if (furnace_hmi_controller_client_generation(&client) != published_generation ||
            (uint32_t)(now - last_publish) >= PUBLISH_INTERVAL_MS) {
            publish(o);
            published_generation = furnace_hmi_controller_client_generation(&client);
            last_publish = now;
        }
        if (o->link != traced_link || o->availability != traced_availability ||
            (uint32_t)(now - last_trace) >= TRACE_INTERVAL_MS) {
            trace(o);
            traced_link = o->link;
            traced_availability = o->availability;
            last_trace = now;
        }
        k_msleep(LINK_POLL_MS);
    }
}

int furnace_hmi_controller_link_start(void)
{
    if (!device_is_ready(link_uart)) {
        return -ENODEV;
    }
    (void)k_thread_create(&link_thread, link_stack, K_THREAD_STACK_SIZEOF(link_stack), link_main,
                          NULL, NULL, NULL, LINK_PRIORITY, 0, K_NO_WAIT);
    k_thread_name_set(&link_thread, "controller_link");
    return 0;
}

bool furnace_hmi_controller_link_take(furnace_hmi_controller_observation_t *out, uint32_t *seen)
{
    bool taken = false;

    if (k_mutex_lock(&mailbox_lock, K_NO_WAIT) != 0) {
        return false;
    }
    if (mailbox_sequence != *seen) {
        *out = mailbox;
        *seen = mailbox_sequence;
        taken = true;
    }
    (void)k_mutex_unlock(&mailbox_lock);
    return taken;
}

uint32_t furnace_hmi_controller_link_submit(const furnace_hmi_command_t *command)
{
    struct command_slot *slot = &command_slots[furnace_hmi_command_is_stop(command->kind) ? 1 : 0];
    uint32_t submission = 0U;
    k_spinlock_key_t key = k_spin_lock(&command_lock);

    if (!slot->full) {
        last_submission = (last_submission == UINT32_MAX) ? 1U : last_submission + 1U;
        submission = last_submission;
        slot->full = true;
        slot->command = *command;
        slot->submission = submission;
    }
    k_spin_unlock(&command_lock, key);
    return submission;
}
```

## src/controller_link.h
```c
/* SPDX-License-Identifier: Apache-2.0 */

#ifndef FURNACE_HMI_ZEPHYR_CONTROLLER_LINK_H
#define FURNACE_HMI_ZEPHYR_CONTROLLER_LINK_H

#include <stdbool.h>
#include <stdint.h>

#include <furnace_hmi/controller_observation.h>

/**
 * Start the link thread: the controller client on the controller-link UART.
 * Returns 0, or a negative error when the UART is not ready.
 */
int furnace_hmi_controller_link_start(void);

/**
 * Copy the newest published observation into out when it is newer than
 * *seen, and update *seen. Never waits (ADR-0005): it returns false when
 * nothing new was published or the link thread is publishing at that moment.
 */
bool furnace_hmi_controller_link_take(furnace_hmi_controller_observation_t *out, uint32_t *seen);

/**
 * Hand an operator command to the link thread, which submits it at its next
 * poll (M21-5). Two slots, ordinary and Stop, so a waiting command never holds
 * up a Stop. Never waits: returns the submission number (never 0) that the
 * observation's command outcome or refusal will carry, or 0 when the slot still
 * holds a command the link thread has not taken.
 */
uint32_t furnace_hmi_controller_link_submit(const furnace_hmi_command_t *command);

#endif /* FURNACE_HMI_ZEPHYR_CONTROLLER_LINK_H */
```

## src/gui_main.c
```c
/* SPDX-License-Identifier: Apache-2.0 */

/*
 * The HMI's Zephyr application on a board with a display. The Zephyr LVGL
 * module initializes LVGL and the display before main; from then on the main
 * thread is the GUI execution context, the only one that changes LVGL
 * (ADR-0005). The one exception is the Zephyr pointer glue, whose input thread
 * reads the LVGL display and its user data, both set before main. Boards
 * without a display build main.c instead.
 *
 * It shows the shared operator screens (Phase 21 M21-2b). The controller link
 * runs in its own thread (controller_link.c); this context takes its newest
 * observation without waiting and maps it to the screens' status model. Every
 * value comes from the controller, the application links no simulator, and
 * the screens get no controller-owned content and no simulated answers: until
 * the controller provides them (M21-7), library, log and clock are shown as
 * unavailable. Manual, Pause, Resume and Stop are commands to the controller
 * (M21-5b); other actions that would change controller state send nothing.
 */

#include <stdint.h>

#include <zephyr/device.h>
#include <zephyr/drivers/display.h>
#include <zephyr/kernel.h>
#include <zephyr/sys/printk.h>

#include <furnace_hmi/controller_dashboard.h>
#include <furnace_hmi/development_marker.h>
#include <furnace_hmi/foundation.h>
#include <furnace_hmi/operator_screens.h>
#include <furnace_hmi/ui_strings.h>
#include <lvgl.h>

#include "controller_link.h"
#include "operator_commands.h"

/* The longest the GUI context sleeps between LVGL timer passes. */
#define GUI_MAX_SLEEP_MS UINT32_C(10)
/* At least one tick, so that native_sim time advances. */
#define GUI_MIN_SLEEP_MS UINT32_C(1)
/*
 * The link thread publishes at least every 200 ms. Nothing for this long means
 * it is stuck (for example in a blocked write): what is shown is then stale.
 */
#define GUI_MAILBOX_STALE_MS UINT32_C(1000)

static furnace_hmi_operator_screens_t screens;
static furnace_hmi_operator_content_t no_content;
static furnace_hmi_controller_observation_t observation;
static furnace_hmi_dashboard_state_t status;

int main(void)
{
    const struct device *display = DEVICE_DT_GET(DT_CHOSEN(zephyr_display));
    uint32_t seen = 0U;
    uint32_t last_taken;
    bool watchdog_stale = false;

    printk("%s (build probe %u)\n",
           furnace_hmi_ui_string(FURNACE_HMI_UI_STRING_APPLICATION_TITLE),
           (unsigned int)furnace_hmi_foundation_probe_version());

    if (!device_is_ready(display) || lv_display_get_default() == NULL) {
        printk("Display not ready for LVGL.\n");
        return 2;
    }
    furnace_hmi_controller_dashboard_state(&observation, &status);
    if (!furnace_hmi_operator_screens_create(&screens, lv_screen_active(), &status, &no_content) ||
        furnace_hmi_development_tag_create(FURNACE_HMI_UI_STRING_SIMULATED_LINK_DEVELOPMENT_LABEL) ==
            NULL) {
        printk("Operator screens could not be created.\n");
        return 13;
    }
    if (furnace_hmi_controller_link_start() != 0) {
        printk("Controller link UART not ready.\n");
        return 3;
    }

    /* Draw the first frame, then show it: the display starts blanked. */
    (void)lv_timer_handler();
    (void)display_blanking_off(display);
    last_taken = k_uptime_get_32();

    for (;;) {
        const uint32_t now = k_uptime_get_32();
        furnace_hmi_operator_request_t request;
        bool refresh = false;
        uint32_t sleep_ms;

        if (furnace_hmi_controller_link_take(&observation, &seen)) {
            last_taken = now;
            watchdog_stale = false;
            refresh = true;
        } else if (!watchdog_stale && (uint32_t)(now - last_taken) >= GUI_MAILBOX_STALE_MS &&
                   observation.availability == FURNACE_HMI_STATE_AVAILABILITY_CURRENT) {
            /* The link thread is silent: show its last values as stale. */
            observation.availability = FURNACE_HMI_STATE_AVAILABILITY_STALE;
            watchdog_stale = true;
            refresh = true;
        }
        if (refresh) {
            furnace_hmi_controller_dashboard_state(&observation, &status);
            (void)furnace_hmi_operator_screens_update(&screens, &status);
        }
        /* The operator's requests go to the link thread; their outcomes come back as feedback. */
        while (furnace_hmi_operator_screens_take_request(&screens, &request)) {
            furnace_hmi_command_t command;
            const uint32_t submission =
                furnace_hmi_operator_command_for(&request, &command)
                    ? furnace_hmi_controller_link_submit(&command)
                    : 0U;

            furnace_hmi_operator_screens_request_submitted(&screens, request.kind, submission);
        }
        sleep_ms = lv_timer_handler();
        if (sleep_ms == LV_NO_TIMER_READY || sleep_ms > GUI_MAX_SLEEP_MS) {
            sleep_ms = GUI_MAX_SLEEP_MS;
        } else if (sleep_ms < GUI_MIN_SLEEP_MS) {
            sleep_ms = GUI_MIN_SLEEP_MS;
        }
        k_msleep((int32_t)sleep_ms);
    }
}
```

## src/operator_commands.c
```c
/* SPDX-License-Identifier: Apache-2.0 */

/* Operator screen requests as controller commands (Phase 21 M21-5b). */

#include "operator_commands.h"

bool furnace_hmi_operator_command_for(const furnace_hmi_operator_request_t *request,
                                      furnace_hmi_command_t *command)
{
    *command = (furnace_hmi_command_t){.run_id = request->run_id};
    switch (request->kind) {
    case FURNACE_HMI_OPERATOR_REQUEST_START_PREPARE:
        command->kind = FURNACE_HMI_COMMAND_START_PREPARE;
        return true;
    case FURNACE_HMI_OPERATOR_REQUEST_MANUAL_START:
        if (request->session_minutes <= 0) {
            return false;
        }
        command->kind = FURNACE_HMI_COMMAND_MANUAL_START;
        command->session_minutes = (uint32_t)request->session_minutes;
        break;
    case FURNACE_HMI_OPERATOR_REQUEST_MANUAL_RETARGET:
        command->kind = FURNACE_HMI_COMMAND_MANUAL_RETARGET;
        break;
    case FURNACE_HMI_OPERATOR_REQUEST_PAUSE:
        command->kind = FURNACE_HMI_COMMAND_PAUSE;
        return true;
    case FURNACE_HMI_OPERATOR_REQUEST_RESUME:
        command->kind = FURNACE_HMI_COMMAND_RESUME;
        return true;
    case FURNACE_HMI_OPERATOR_REQUEST_STOP:
        command->kind = FURNACE_HMI_COMMAND_STOP;
        return true;
    case FURNACE_HMI_OPERATOR_REQUEST_CONTINUE:
        command->kind = FURNACE_HMI_COMMAND_CONTINUE;
        return true;
    case FURNACE_HMI_OPERATOR_REQUEST_FAULT_ACKNOWLEDGE:
        command->kind = FURNACE_HMI_COMMAND_FAULT_ACKNOWLEDGE;
        command->fault_id = request->fault_id;
        command->source = request->source;
        return true;
    case FURNACE_HMI_OPERATOR_REQUEST_FAULT_RECOVERY:
        command->kind = FURNACE_HMI_COMMAND_FAULT_RECOVERY;
        command->fault_id = request->fault_id;
        command->source = request->source;
        return true;
    default:
        return false;
    }
    command->target_decicelsius = request->target_c * 10;
    command->rate_decicelsius_per_min = request->rate_tenths_c_per_minute;
    return true;
}
```

## src/operator_commands.h
```c
/* SPDX-License-Identifier: Apache-2.0 */

#ifndef FURNACE_HMI_ZEPHYR_OPERATOR_COMMANDS_H
#define FURNACE_HMI_ZEPHYR_OPERATOR_COMMANDS_H

#include <stdbool.h>
#include <stdint.h>

#include <furnace_hmi/controller_command.h>
#include <furnace_hmi/operator_screens.h>

/**
 * The controller command for an operator screen request (Phase 21 M21-5b):
 * whole degrees become 0.1 °C, and run commands name the run the operator saw
 * when acting (the request's run_id). False for requests that are not commands yet
 * (program Start and closing a run: M21-7); the host then hands nothing over.
 */
bool furnace_hmi_operator_command_for(const furnace_hmi_operator_request_t *request,
                                      furnace_hmi_command_t *command);

#endif /* FURNACE_HMI_ZEPHYR_OPERATOR_COMMANDS_H */
```
